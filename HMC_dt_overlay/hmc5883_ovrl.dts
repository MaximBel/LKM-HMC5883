// Definitions for HMC5883 magnitometer
/dts-v1/;
/plugin/;

/ {
        compatible = "brcm,bcm2708";

        fragment@0 {
                target = <&i2c_arm>;
                __overlay__ {
                        #address-cells = <1>;
                        #size-cells = <0>;
                        status = "okay";

                        hmc5883@1E {
                                compatible = "honeywell,hmc5883";
                                reg = <0x1E>;
                                status = "okay";
                        };
                };
        };
};
